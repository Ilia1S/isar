## meta-isar/conf/machine/phyboard-mira.conf
```bitbake
# This software is a part of Isar.
# Copyright (C) 2022-2024 ilbers GmbH
#
# SPDX-License-Identifier: MIT

DISTRO_ARCH ?= "armhf"

KERNEL_NAME ?= "phy"

MACHINE_SERIAL ?= "ttymxc0"
BAUDRATE_TTY ?= "115200"

IMAGE_TYPEDEP:ubi += "ubifs"

MKUBIFS_ARGS := "-m 0x800 -e 0x1f000 -c 8012"
UBINIZE_ARGS = "-vv -m 0x800 -p 0x20000"
IMAGE_FSTYPES ?= "ubi ubifs wic"
WKS_FILE ?= "phyboard-mira"

DTB_FILES = "imx6q-phytec-mira-rdk-nand.dtb"

IMAGE_INSTALL += "barebox"
IMAGE_INSTALL:wic += "barebox"
IMAGER_BUILD_DEPS += "barebox"

BAREBOX_CONFIG = "imx_v7_defconfig"
BAREBOX_ENV = "phytec-mira-env"
BAREBOX_BASE_BIN = "barebox-phytec-phycore-imx6q-som-nand-1gib"

IMAGE_BOOT_FILES = "isar-image-base-debian-bullseye-phyboard-mira-vmlinuz ${DTB_FILES}"
```

## meta-isar/conf/machine/stm32mp15x.conf
```bitbake
#
# Copyright (C) Siemens AG, 2020
# Copyright (C) 2024 ilbers GmbH
#
# SPDX-License-Identifier: MIT

DISTRO_ARCH ?= "armhf"

KERNEL_NAME ?= "stm32mp1"

U_BOOT_CONFIG:stm32mp15x = "stm32mp15_defconfig"
U_BOOT_BIN:stm32mp15x = "u-boot-nodtb.bin u-boot.dtb"

IMAGE_FSTYPES ?= "wic"
WKS_FILE ?= "stm32mp15x.wks.in"
IMAGER_INSTALL:wic += "trusted-firmware-a-stm32mp15x"
IMAGER_BUILD_DEPS += "trusted-firmware-a-stm32mp15x"

IMAGE_INSTALL += "u-boot-script \
    optee-examples-stm32mp15x-acipher-host \
    optee-examples-stm32mp15x-aes-host \
    optee-examples-stm32mp15x-hello-world-host \
    optee-examples-stm32mp15x-hotp-host \
    optee-examples-stm32mp15x-random-host \
    optee-examples-stm32mp15x-secure-storage-host \
    initramfs-tee-supplicant-hook \
    initramfs-tee-ftpm-hook \
    "
```

## meta-isar/scripts/lib/wic/canned-wks/phyboard-mira.wks
```
# This software is a part of Isar.
# Copyright (C) 2024 ilbers GmbH

part BAREBOX --source rawcopy --sourceparams="file=barebox.bin,skip=1024" --ondisk mmc --no-table --align 1

part --source bootimg-partition --fstype=vfat --label boot --ondisk mmc --active --align 4096 --size 20
part / --source rootfs --fstype=ext4 --mkfs-extraopts "-I 256" --label root --ondisk mmc --align 1024 --use-uuid

bootloader --timeout=0
```
